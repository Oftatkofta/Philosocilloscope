byte Xpins[] = {
  2, 3, 4, 5, 6, 7, 8, 9 //LSB->MSB
};
byte Ypins[] = {
  12, 13, A5, A4, A3, A2, A1, A0 //LSB->MSB
};
int d;

byte shapeX[] = {255, 255, 255, 254, 254, 253, 252, 251, 250, 249, 247, 246, 244,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 237, 237};
byte shapeY[] = {127, 131, 136, 140, 145, 149, 154, 158, 162, 167, 171, 175, 179,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 121, 237};



void setup() {
  //Serial.begin(115200);
  d = 0;

  // for loop to initialize each pin as an output:
  for (int i = 0; i < 8; i++)  {
    pinMode(Xpins[i], OUTPUT);
    pinMode(Ypins[i], OUTPUT);

  }
}
void loop() {
  if (d > sizeof(shapeX) - 1) {
    d = 0;
  }
  painter3(shapeX[d], shapeY[d], Xpins, Ypins);
  delay(3);
  d++;
}

void painter3(int coordinateX, int coordinateY, byte pinArrayX[], byte pinArrayY[]) {
  for (int i = 0; i < 8; i++) {

    if (bitRead(coordinateX, i)) {
    digitalWrite(pinArrayX[i], HIGH);
    }
    else {
      digitalWrite(pinArrayX[i], LOW);
    }

    if (bitRead(coordinateY, i)) {
    digitalWrite(pinArrayY[i], HIGH);
    }
    else {
      digitalWrite(pinArrayY[i], LOW);
    }
  }
}
